## firmware/main/Kconfig.projbuild
```kconfig
menu "ESP_CAM Configuration"

    config ESP_CAM_WIFI_SSID
        string "Nombre de la red WiFi (SSID)"
        default ""
        help
            Red a la que se conecta la camara. Se guarda en sdkconfig, que esta
            en .gitignore, asi que no acaba en el repositorio.

    config ESP_CAM_WIFI_PASSWORD
        string "Contrasena de la red WiFi"
        default ""
        help
            Dejar vacio para redes abiertas.

    config ESP_CAM_SERVER_URL
        string "URL base del proxy de estilizacion"
        default "https://cam.j-cardenas.com"
        help
            Sin barra final. El firmware le anade /health y /stylize.
            Con https:// se valida el certificado contra el bundle de CA de
            ESP-IDF. Para un proxy en la LAN vale http://IP-DEL-PC:8000, pero
            nunca 127.0.0.1, que para la placa es ella misma.

    config ESP_CAM_AUTH_TOKEN
        string "Token compartido con el proxy"
        default ""
        help
            Tiene que coincidir con ESPCAM_TOKEN del .env del servidor. Se manda
            como cabecera Authorization: Bearer. Dejarlo vacio solo si el proxy
            esta en una LAN cerrada; publicado en internet, sin token cualquiera
            puede gastar el saldo de OpenAI. Se guarda en sdkconfig, que esta en
            .gitignore.

    config ESP_CAM_HTTP_TIMEOUT_MS
        int "Timeout de las peticiones HTTP (ms)"
        default 90000

endmenu
```
